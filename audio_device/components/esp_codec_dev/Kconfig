## audio_device/components/esp_codec_dev/Kconfig
```kconfig
menu "Audio Codec configuration"

    config CODEC_ES8311_SUPPORT
        bool "Support ES8311 Codec Chip"
        default y
        help
            Enable this option if you want to use codec ES8311.

    config CODEC_ES7210_SUPPORT
        bool "Support ES7210 Codec Chip"
        default y
        help
            Enable this option if you want to use codec ES7210.

    config CODEC_TAS5805M_SUPPORT
        bool "Support TAS5805M Codec Chip"
        default y
        help
            Enable this option if you want to use codec TAS5805M.

 endmenu
```

## audio_device/sdkconfig.defaults
```kconfig
#
# Serial flasher config
#
CONFIG_ESPTOOLPY_FLASHMODE="qio"
CONFIG_ESPTOOLPY_FLASHFREQ_80M=y
CONFIG_ESPTOOLPY_FLASHSIZE_4MB=y
CONFIG_ESPTOOLPY_BAUD_921600B=y
CONFIG_ESPTOOLPY_BAUD=921600
CONFIG_OPTIMIZATION_LEVEL_RELEASE=y
CONFIG_ESPTOOLPY_FLASHSIZE_4MB=y

#
# ESP32-specific
#
CONFIG_ESP32_DEFAULT_CPU_FREQ_240=y
CONFIG_ESP32_DEFAULT_CPU_FREQ_MHZ=240


# Increase default app partition size to accommodate console example
CONFIG_PARTITION_TABLE_CUSTOM=y
CONFIG_PARTITION_TABLE_CUSTOM_FILENAME="partitions_codec_example.csv"
CONFIG_PARTITION_TABLE_CUSTOM_APP_BIN_OFFSET=0x10000
CONFIG_PARTITION_TABLE_FILENAME="partitions_codec_example.csv"
CONFIG_APP_OFFSET=0x10000

CONFIG_FATFS_LFN_HEAP=y
# CONFIG_FATFS_LFN_STACK is not set
CONFIG_FATFS_MAX_LFN=255
CONFIG_FATFS_API_ENCODING_ANSI_OEM=y
# CONFIG_FATFS_API_ENCODING_UTF_16 is not set
# CONFIG_FATFS_API_ENCODING_UTF_8 is not set
```
